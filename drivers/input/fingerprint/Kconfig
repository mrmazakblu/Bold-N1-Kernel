## drivers/input/fingerprint/Kconfig
```kconfig
#
#Fingerprint
#
menu "Fingerprint support"
	depends on INPUT

config MTK_FINGERPRINT_SUPPORT
	bool "Mediatek Fingerprint"
	default n
	---help---
	Fingerprint mtk driver enable/disable in the kernel.
	Say Y here if you want to use mediatek fingerprint driver,
	fingerprint driver will support fingerprint function

if MTK_FINGERPRINT_SUPPORT
config MTK_FINGERPRINT_SELECT
	string "sensor type"
	default "GF318M"


if MTK_FINGERPRINT_SELECT = "FPC1145"
config FPC_FINGERPRINT
	bool "FPC Fingerprint"
	default y
	---help---
	FPC fingerprint FPC's 102x/104x device.
endif

if MTK_FINGERPRINT_SELECT = "GF318M" ||  MTK_FINGERPRINT_SELECT = "GF5216"
config GOODIX_FINGERPRINT
	bool "Goodix Fingerprint"
	default n
	---help---
	Goodix Fingerprint chip GF316M/GF318M/GF3118M/GF518M/GF5118M/GF516M/GF816M/GF3208/GF3206/GF3266/GF3288/GF5206/GF5216/GF5208 TEE driver

config GOODIX_SENSOR_TYPE
	string "SENSOR_TYPE"
	default "GF5216"
	---help---
	Must input sensor type, or default is GF316M GF318M GF3118M GF518M GF5118M GF516M GF816M GF3208 GF3206 GF3266 GF3288 GF5206 GF5216 GF5208
endif
# begin, prize-lifenfen-20190104, add for ata sunwave fp
if MTK_FINGERPRINT_SELECT = "sunwavecorp_fp"
  config SUNWAVE_FINGERPRINT
     bool "SUNWAVE Fingerprint"
     default y
     ---help---
     MICROARRAY fingerprint SUNWAVE's device.
endif
# end, prize-lifenfen-20190104, add for ata sunwave fp
# begin, prize-pengguangyi-20190121, add for goodix gf5118m fp
config GOODIX_GF5118M_FINGERPRINT
	bool "Goodix GF5118M Fingerprint"
	default n
	---help---
	Goodix Fingerprint chip GF316M/GF318M/GF3118M/GF518M/GF5118M/GF516M/GF816M/GF3208/GF3206/GF3266/GF3288/GF5206 TEE driver
endif
# end, prize-pengguangyi-20190121, add for goodix gf5118m fp
#prize-add finger-pengzhipeng-20190419-start

if MTK_FINGERPRINT_SELECT = "ft9362"
  config FT9362_FINGERPRINT
     bool "FT9362 Fingerprint"
     default y
     ---help---
     MICROARRAY fingerprint FT9362's device.
endif

if MTK_FINGERPRINT_SELECT = "ft9362_tee"
  config FT9362_FINGERPRINT_TEE
     bool "FT9362 TEE Fingerprint"
     default y
     ---help---
     MICROARRAY fingerprint FT9362 TEE's device.
endif
#prize-add finger-pengzhipeng-20190419-end
endmenu
```

## drivers/misc/mediatek/prize/Kconfig
```kconfig
config PRIZE_LCD_BIAS
  bool CONFIG_PRIZE_LCD_BIAS
  default no
  help
    CONFIG_PRIZE_LCD_BIAS

source "drivers/misc/mediatek/prize/lcdbias/Kconfig
source "drivers/misc/mediatek/prize/hall/Kconfig
```

## drivers/misc/mediatek/prize/hall/Kconfig
```kconfig
# prize-dingjun-20150410-start
#config MTK_HALLDEVICE
config PRIZE_HALL
	bool "hall device"
	default n
	help
	  Select Y to enable hall device support
# prize-dingjun-20150410-end
#
#
#
```

## drivers/misc/mediatek/prize/lcdbias/Kconfig
```kconfig
config PRIZE_LCD_BIAS_TPS65132
  bool CONFIG_PRIZE_LCD_BIAS_TPS65132
  depends on PRIZE_LCD_BIAS
  default no
  help
    CONFIG_PRIZE_LCD_BIAS_TPS65132
```

## drivers/misc/mediatek/rtc/Kconfig
```kconfig
# RTC Related
config MTK_RTC
	bool "MediaTek Real Time Clock Support"
	default n
	help
	  A real-time clock (RTC) is a computer
	  clock (most often in the form of an
	  integrated circuit) that keeps track
	  of the current time.
# prize added by pengzhipeng, EMMC TEST, 20190321-start
config PRIZE_DDR_TEST
	bool "MediaTek Real Time Clock Support"
	default n
	---help---
	  PRIZE_DDR_TEST driver
# prize added by chenjiaxi, EMMC TEST, 20190321-end
```
